## boards/shields/tanx66oled/Kconfig.defconfig
```kconfig
if SHIELD_TANX66OLED

config ZMK_KEYBOARD_NAME
    default "tanx66oled"

config USB_DEVICE_PRODUCT
      default "tanx66oled"

    config BT_DEVICE_NAME
      default "tanx66oled"

if ZMK_DISPLAY

    config I2C
      default y

    config SSD1306
      default y

endif # ZMK_DISPLAY

if LVGL

     config LV_Z_VDB_SIZE
      default 64

     config LV_DPI_DEF
      default 148

    config LV_Z_BITS_PER_PIXEL
      default 1

    choice LV_COLOR_DEPTH
      default LV_COLOR_DEPTH_1
      endchoice

endif # LVGL

    config SPI
      default y

    config ZMK_BLE
      default y

    config ZMK_USB
      default y 

endif
```

## zephyr/modules/hall_effect/Kconfig
```kconfig
menu "Hall Effect Module"

config HALL_EFFECT
    bool "Enable Hall Effect module"
    default y

config HALL_ADC_SAMPLES
    int "Number of ADC samples to average"
    default 8

config HALL_ADC_SAMPLE_INTERVAL_MS
    int "Interval between ADC samples (ms)"
    default 4

config HALL_ADC_HYST_MV
    int "Hysteresis (mV)"
    default 50

config HALL_ADC_CALIBRATE_ON_BOOT
    bool "Auto-calibrate on boot"
    default y

config HALL_SOCD_POLICY
    int "SOCD policy (0=NEUTRAL,1=UP_PRIORITY,2=LAST)"
    default 0

endmenu
```
